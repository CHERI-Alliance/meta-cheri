## meta-cheri-bsp/conf/machine/cva6cheri.conf
```bitbake
PREFERRED_PROVIDER_virtual/bootloader ?= "u-boot-cheri"
PREFERRED_PROVIDER_virtual/kernel ?= "linux-cheri"

require conf/machine/include/riscv/tune-riscv-cheri.inc
require conf/machine/include/riscv/tune-riscv.inc

DEFAULTTUNE:cheri = "riscv64cheri"

MACHINE_FEATURES += "keyboard ext2 ext3 serial"

KERNEL_IMAGETYPE = "Image"
KERNEL_IMAGETYPES += "Image.gz"
KEEPUIMAGE = "no"

SERIAL_CONSOLES ?= "115200;ttyS0"

IMAGE_FSTYPES += "ext4 wic"

QEMU_CHERI_IMAGE_ROOTFS_SIZE ?= "2G"

WKS_FILE ?= "cva6cheri.wks"
WKS_FILE_DEPENDS:append = " opensbi"

MACHINE_EXTRA_RRECOMMENDS += " kernel-modules"

EXTRA_IMAGEDEPENDS += "opensbi"
RISCV_SBI_PLAT ?= "generic"
RISCV_SBI_PAYLOAD ?= "u-boot.bin"

UBOOT_ENTRYPOINT:riscv64 = "0x80200000"
UBOOT_MACHINE = "codasip-a730-hobgoblin_cheri_purecap_smode_defconfig"

IMAGE_BOOT_FILES ?= "Image.gz"
```

## meta-cheri-bsp/wic/cva6cheri.wks
```
bootloader --ptable gpt

part --source rawcopy --fstype=none --sourceparams="file=fw_payload.bin"
part --source bootimg-partition --active --fstype=vfat --fixed-size 32M
part / --source rootfs --fstype=ext4
```
